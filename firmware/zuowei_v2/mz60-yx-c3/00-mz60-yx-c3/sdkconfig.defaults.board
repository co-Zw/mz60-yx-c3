## firmware/zuowei_v2/mz60-yx-c3/00-mz60-yx-c3/sdkconfig.defaults.board
```kconfig
CONFIG_BOARD_PATH="../../firmware/zuowei_v2/mz60-yx-c3/00-mz60-yx-c3"
CONFIG_ASSETS_FIX_PATH="../firmware/_common_v2/assets_fix"

CONFIG_IOT_PROTOCOL_XIAOZHI=n
CONFIG_IOT_PROTOCOL_MCP=y

CONFIG_WIFI_CONFIG_MODE_FORMAT_DISPLAY=y
CONFIG_WIFI_CONFIG_MODE_SSID_PREFIX="zuowei"

CONFIG_UI_STATUS_BAR_PAD=12

CONFIG_SPEAKING_FIRST_MUTE_TIME=60

CONFIG_USE_CUSTOM_OTA=y

CONFIG_VB6824_OTA_SUPPORT=n

# 阿拉伯字体处理
#CONFIG_LV_USE_BIDI=y
#CONFIG_LV_BIDI_DIR_AUTO=y
#CONFIG_LV_USE_ARABIC_PERSIAN_CHARS=y

CONFIG_COMPILER_OPTIMIZATION_PERF=y

CONFIG_ESP_WIFI_STATIC_RX_BUFFER_NUM=10
CONFIG_ESP_WIFI_DYNAMIC_RX_BUFFER_NUM=32

CONFIG_ESP_WIFI_DYNAMIC_TX_BUFFER=y
CONFIG_ESP_WIFI_DYNAMIC_TX_BUFFER_NUM=32

CONFIG_ESP_WIFI_STATIC_RX_MGMT_BUFFER=y
CONFIGESP_WIFI_RX_MGMT_BUF_NUM_DEF=5

CONFIG_ESP_WIFI_RX_BA_WIN=6

CONFIG_LWIP_TCPIP_RECVMBOX_SIZE=16

CONFIG_MBEDTLS_DYNAMIC_FREE_CONFIG_DATA=y


CONFIG_ESP_WIFI_ENABLE_WPA3_SAE=y
CONFIG_LWIP_IPV6=y
CONFIG_LWIP_TCPIP_RECVMBOX_SIZE=16

#CONFIG_FREERTOS_IDLE_TASK_STACKSIZE=1536

CONFIG_VB_UART_RX_BUFFER_SIZE=6144

CONFIG_ESP_WIFI_IRAM_OPT=y
```
